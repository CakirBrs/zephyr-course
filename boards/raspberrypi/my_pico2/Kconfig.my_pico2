## boards/raspberrypi/my_pico2/board.yml
```yaml
board:
  name: my_pico2
  full_name: My Pico 2
  vendor: raspberrypi
  socs:
  - name: rp2350a
```

## boards/raspberrypi/my_scratch/board.yml
```yaml
board:
  name: my_scratch
  full_name: My Scratch RP2350 Board
  vendor: raspberrypi
  socs:
  - name: rp2350a
```
