## CMakeLists.txt
```
cmake_minimum_required(VERSION 3.20.0)

find_package(Zephyr REQUIRED)
project(my_zephyr_app)

target_sources(app PRIVATE src/main.cpp src/sensor_shell.c drivers/led_sensor/led_sensor.c)
target_include_directories(app PRIVATE drivers/led_sensor)
```

## Kconfig
```
menuconfig LED_SUBSYSTEM
	bool "LED Subsystem"

if LED_SUBSYSTEM

choice
	prompt "LED blink sleep time"
	default LED_BLINK_SLEEP_1S
config LED_BLINK_SLEEP_250MS
	bool "250ms (fast)"
config LED_BLINK_SLEEP_500MS
	bool "500ms"
config LED_BLINK_SLEEP_1S
	bool "1s (medium)"
config LED_BLINK_SLEEP_2S
	bool "2s (slow)"
endchoice

config LED_BLINK_SLEEP_MS
	int
	default 250 if LED_BLINK_SLEEP_250MS
	default 500 if LED_BLINK_SLEEP_500MS
	default 1000 if LED_BLINK_SLEEP_1S
	default 2000 if LED_BLINK_SLEEP_2S

menuconfig LED_ADVANCED
	bool "Advanced LED settings"

if LED_ADVANCED

config LED_BRIGHTNESS
	int "LED brightness (0-100)"
	default 100
	range 0 100

config LED_FADE_DURATION_MS
	int "LED fade duration (ms)"
	default 500
	range 0 5000

menu "Expert settings"
	visible if LED_ADVANCED

config LED_DEBUG
	bool "Enable LED debugging"
config LED_CUSTOM_BLINK_PATTERN
	bool "Custom blink pattern"

endmenu

endif # LED_ADVANCED

endif # LED_SUBSYSTEM

config APP_HEARTBEAT_PERIOD_MS
	int "Heartbeat LED period (ms)"
	default 500
	range 100 2000

source "Kconfig.zephyr"
```

## prj.conf
```kconfig
CONFIG_GPIO=y
CONFIG_LOG=y
CONFIG_SENSOR=y
CONFIG_SHELL=y
```

## app.overlay
```dts
#include <zephyr/dt-bindings/gpio/gpio.h>

/ {
	led_sensor: led_sensor {
		compatible = "myco,led-sensor";
		gpios = <&gpio0 2 GPIO_ACTIVE_HIGH>;   /* GPIO2 — boş, strapping değil */
	};
};
```

## dts/bindings/sensor/myco,led-sensor.yaml
```yaml
description: Simple on-board LED exposed as a sensor

compatible: "myco,led-sensor"

include: base.yaml

properties:
  gpios:
    type: phandle-array
    required: true
```

## src/main.cpp
```c
#include <zephyr/drivers/gpio.h>
#include <zephyr/kernel.h>
#include <zephyr/logging/log.h>
#include <zephyr/drivers/sensor.h>
#include "led_sensor.h"
//#define SLEEP_TIME_MS 1000

/* The devicetree node identifier for the "led0" alias. */
//#define LED_NODE DT_ALIAS(led0)
//#define APP_LED_NODE DT_ALIAS(app_led)


//static const struct gpio_dt_spec led = GPIO_DT_SPEC_GET(LED_NODE, gpios);
//static const struct gpio_dt_spec heartbeat = GPIO_DT_SPEC_GET(APP_LED_NODE, gpios);

//LOG_MODULE_REGISTER(main, LOG_LEVEL_INF);

int main(void)
{
    /*
    bool led_state = true;

    if (!gpio_is_ready_dt(&heartbeat)) return 0;

    if (gpio_pin_configure_dt(&heartbeat, GPIO_OUTPUT_ACTIVE) < 0) return 0;

    LOG_INF("Heartbeat period: %d ms", CONFIG_APP_HEARTBEAT_PERIOD_MS);
*/
    const struct device *sensor = DEVICE_DT_GET_ANY(myco_led_sensor);
    if (sensor == NULL || !device_is_ready(sensor)) {
		return 0;
	}

	struct sensor_value val;
    led_sensor_set_blink_count(sensor, 10);
    while (1) {
        //if (gpio_pin_toggle_dt(&heartbeat) < 0) return 0;

        //led_state = !led_state;
        //LOG_INF("LED state: %s", led_state ? "ON" : "OFF");
        //k_msleep(CONFIG_APP_HEARTBEAT_PERIOD_MS);
        sensor_sample_fetch(sensor); //LED ON
        k_msleep(500);
		sensor_channel_get(sensor, SENSOR_CHAN_ALL, &val); //LED OFF
		k_msleep(500);
    }
    return 0;
}
```

## src/sensor_shell.c
```c
#include <zephyr/device.h>
#include <zephyr/drivers/sensor.h>
#include <zephyr/shell/shell.h>
#include <stdlib.h>

#include "led_sensor.h"

#define SENSOR_DEV DEVICE_DT_GET_ANY(myco_led_sensor)
#define BLINK_COUNT_MIN 0
#define BLINK_COUNT_MAX 100

static int cmd_sensor_fetch(const struct shell *sh, size_t argc, char **argv)
{
	const struct device *dev = SENSOR_DEV;

	if (dev == NULL || !device_is_ready(dev)) {
		shell_error(sh, "sensor not ready");
		return -ENODEV;
	}

	int ret = sensor_sample_fetch(dev);

	if (ret < 0) {
		shell_error(sh, "fetch failed: %d", ret);
		return ret;
	}
	shell_print(sh, "fetch ok (LED on)");
	return 0;
}

static int cmd_sensor_read(const struct shell *sh, size_t argc, char **argv)
{
	const struct device *dev = SENSOR_DEV;
	struct sensor_value val;

	if (dev == NULL || !device_is_ready(dev)) {
		shell_error(sh, "sensor not ready");
		return -ENODEV;
	}

	int ret = sensor_channel_get(dev, SENSOR_CHAN_ALL, &val);

	if (ret < 0) {
		shell_error(sh, "read failed: %d", ret);
		return ret;
	}
	shell_print(sh, "read: %d.%06d (LED off)", val.val1, val.val2);
	return 0;
}

static int cmd_sensor_info(const struct shell *sh, size_t argc, char **argv)
{
	const struct device *dev = SENSOR_DEV;

	if (dev == NULL) {
		shell_error(sh, "no sensor device found");
		return -ENODEV;
	}
	shell_print(sh, "name : %s", dev->name);
	shell_print(sh, "ready: %s", device_is_ready(dev) ? "yes" : "no");
	return 0;
}



static int cmd_sensor_set(const struct shell *sh, size_t argc, char **argv)
{
	const struct device *dev = SENSOR_DEV;

	if (dev == NULL || !device_is_ready(dev)) {
		shell_error(sh, "sensor not ready");
		return -ENODEV;
	}

	char *end;
	long value = strtol(argv[1], &end, 10);

	if (*end != '\0') {
		shell_error(sh, "invalid number: %s", argv[1]);
		return -EINVAL;
	}
	if (value < BLINK_COUNT_MIN || value > BLINK_COUNT_MAX) {
		shell_error(sh, "out of range (%d..%d): %ld",
			    BLINK_COUNT_MIN, BLINK_COUNT_MAX, value);
		return -EINVAL;
	}

	led_sensor_set_blink_count(dev, (uint32_t)value);
	shell_print(sh, "blink_count set to %ld", value);
	return 0;
}

/* Alt-komutlar */
SHELL_STATIC_SUBCMD_SET_CREATE(sensor_cmds,
	SHELL_CMD(fetch, NULL, "Call sensor_sample_fetch (LED on)", cmd_sensor_fetch),
	SHELL_CMD(read,  NULL, "Call sensor_channel_get (LED off)", cmd_sensor_read),
	SHELL_CMD(info,  NULL, "Print device name and ready state", cmd_sensor_info),
    SHELL_CMD_ARG(set, NULL, "Set blink_count: sensor set <value>", cmd_sensor_set, 2, 0),
	SHELL_SUBCMD_SET_END
);

SHELL_CMD_REGISTER(sensor, &sensor_cmds, "LED-sensor driver commands", NULL);
```
